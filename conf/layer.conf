## conf/layer.conf
```bitbake
# We have a conf and classes directory, add to BBPATH
BBPATH .= ":${LAYERDIR}"

# We have recipes-* directories, add to BBFILES
BBFILES += "${LAYERDIR}/recipes-*/*/*.bb \
            ${LAYERDIR}/recipes-*/*/*.bbappend"

BBFILE_COLLECTIONS += "meta-compulab-helper"
BBFILE_PATTERN_meta-compulab-helper = "^${LAYERDIR}/"
BBFILE_PRIORITY_meta-compulab-helper = "6"

LAYERDEPENDS_meta-compulab-helper = "core"
LAYERSERIES_COMPAT_meta-compulab-helper = "mickledore nanbield scarthgap"

SERIAL_CONSOLES:${MACHINE} = "115200;ttymxc3"
```
